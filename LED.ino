#ifdef NUM_MATRIXLEDS
#include<FastLED.h>
#define LEDPIN 13
#define WIDTH 8
#define MAXBARWIDTH 4
#define LEDSHOW true
#define DATA_PIN    13
#define LED_TYPE    WS2812
#define COLOR_ORDER GRB

#define BRIGHTNESS   40

byte ledPixel[] = {0x0, 0x0, 0x0, 0x0, 0xF4, 0x0, 0xC0, 0x0, 0xC0, 0x28, 0x7C, 0x28, 0x7C,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 0x40, 0x80};
int rowPos[] = {0, 3, 5, 9, 14, 19, 24, 29, 32, 35, 38, 43, 46,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 341, 341};


void initLED() {
  FastLED.addLeds<LED_TYPE, DATA_PIN, COLOR_ORDER>(leds, NUM_MATRIXLEDS).setCorrection(TypicalLEDStrip);
  // set master brightness control
  FastLED.setBrightness(BRIGHTNESS);
  Serial.println("initLED done");
  myDelay(500);
  LEDText(WiFi.localIP().toString(), true);
  delay(10);
}

void LEDShow() {
  FastLED.show();
  //delay(10);
  myDelay(10);
}

void LEDDots(int dot) {
  for (int j = 0; j < dot; j++) {
    leds[j] = CRGB::Red;
  }
  for (int j = dot; j < (int) NUM_MATRIXLEDS; j++) {
    leds[j] = CRGB::Black;
  }
}

void displayWeather(byte myImage[]) {
  for (int i = 0; i < 64; i++) {
    //leds[i] = myImage[i * 3] * 255 * 255 + myImage[i * 3 + 1] * 255 + myImage[i * 3 + 2];
    leds[i][1] = myImage[i * 3];
    leds[i][0] = myImage[i * 3 + 1];
    leds[i][2] = myImage[i * 3 + 2];
  }
  LEDShow();
  myDelay(1000);
}


// draw a red pixel for each dot
void LEDLight(int dot) {
  for (int j = 0; j < NUM_MATRIXLEDS; j++) {
    //Serial.print(strip.getPixelColor(49));
    leds[j] = CRGB::Red;
    //strip.setPixelColor(j, 0, 0, 10);
  }
  LEDShow();
}

void LED( LEDModes ledmode) {
  /*   BLACK,
    WHITE,
    RAINBOW */
  Serial.print("LED Modes ");
  Serial.println(ledmode);

  for (int j = 0; j < (int) NUM_MATRIXLEDS; j++) {
    switch (ledmode) {
      case BLACK:
        leds[j] = CRGB::Black;
        break;
      case WHITE:
        leds[j] = CRGB::White;
        break;

      case RAINBOW:
        fill_rainbow( leds, NUM_MATRIXLEDS, 0, 3);
        break;
    }
  }
  LEDShow();
  delay(100);
}

void LEDText(String welcome, bool animate) {
  int slice = 0;
  int endSlice = 1;
  Serial.println(welcome);
  if (animate) {
    for (int letter = 0; letter < welcome.length(); letter++) {

      endSlice += rowPos[welcome.charAt(letter) - 32 + 1] - rowPos[welcome.charAt(letter) - 32];
    }
    endSlice += welcome.length();
    if (endSlice > 16) {
      endSlice = endSlice - 16;
    } else {
      endSlice = 0;
    }

  }
  for (slice = 0; slice < endSlice; slice++) {
    int xpos = 0;
    int pixelNo = 0;

    if (touch2detected) {
      Serial.println("Touch2 detected");
      return;
    }

    for (int letter = 0; letter < welcome.length(); letter++) {
      //Serial.print(welcome.charAt(letter));
      for (int column = rowPos[welcome.charAt(letter) - 32]; column < rowPos[welcome.charAt(letter) - 32 + 1]; column++) {
        for (int row = 0; row < 8; row++) {
          pixelNo = xpos * 8  + row - slice * 8;
          if (pixelNo >= 0 && pixelNo < (int)  NUM_MATRIXLEDS) {

            if (ledPixel[column] & (1 << row) ) {
              leds[xpos * 8  + row - slice * 8] = CRGB::Red;

            } else {
              leds[xpos * 8  + row - slice * 8] = CRGB::Black;
            }
          }
        }

        xpos++;

      }
      // spacer
      for (int row = 0; row < 8; row++) {
        pixelNo = xpos * 8  + row - slice * 8;
        if (pixelNo >= 0 && pixelNo < ((int)  NUM_MATRIXLEDS)) {
          leds[xpos * 8 + row - slice * 8] = CRGB::Black;
          //strip.setPixelColor(xpos * 8 + row - slice * 8, 0, 0, 3);
        }
      }
      xpos++;
      myDelay(10);

    }
    FastLED.show();
    if (slice == endSlice) {
      myDelay(400);
    } else {
      myDelay(200);
    }
  }
}

#else

// dummy entry
void LEDShow() {
  myDelay(10);
  Serial.print("!");
}

void LEDText(String welcome, bool animate) {
  myDelay(10);
  Serial.println(welcome);
}

void LED( LEDModes ledmode) {
  Serial.println("LED");
}

void LEDDots(int dot) {
  Serial.print(".");
}

void initLED() {
  Serial.println("initLED");
}

#endif
